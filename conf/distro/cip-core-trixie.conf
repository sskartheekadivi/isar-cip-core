## conf/distro/cip-core-trixie.conf
```bitbake
#
# CIP Core, generic profile
#
# Copyright (c) Siemens AG, 2024-2025
#
# Authors:
#  Cedric Hombourger <cedric.hombourger@siemens.com>
#
# SPDX-License-Identifier: MIT
#

require conf/distro/debian-trixie.conf
require cip-core-common.inc
```

## wic/bbb.wks
```
#
# CIP Core, generic profile
#
# Copyright (c) Siemens AG, 2019-2025
#
# SPDX-License-Identifier: MIT
#

part --source rawcopy --sourceparams "file=/usr/lib/u-boot/bbb/MLO" --no-table --align 128
part --source rawcopy --sourceparams "file=/usr/lib/u-boot/bbb/u-boot.img" --no-table --align 384

part /boot --source bootimg-efi-isar --sourceparams "loader=systemd-boot,dtb=am335x-boneblack.dtb" --label efi --part-type EF00 --align 1024 --fsuuid 0x4321dcba --uuid 16d61432-ec24-42fa-a4b8-b2bc20a26f5e --use-uuid
part / --source rootfs --fstype ext4 --mkfs-extraopts "-T default" --label platform --align 1024 --fsuuid 1f55d66a-40d8-11ee-be56-0242ac120002 --uuid 25d57b24-f34d-412e-8c88-28629f23aa0d --use-uuid

bootloader --ptable gpt --timeout=0 --append "rootwait console=ttyO0,115200"
```
